/* Code for a how to on PocketPC.ch:
 * DIY: Mute Button für Zoom, WebEx, Jitsi, BigBlueButton etc. selbst gebaut
 * https://www.pocketpc.ch/magazin/tutorial/smart-home-tutorials/diy-mute-button-fuer-zoom-webex-jitsi-bigbluebutton-etc-selbst-gebaut-77105/
 * using an ATMEL ATmega32U4 Arduino Pro Micro (clone) to emulate a USB HID device for mute/unmute video conference software such as Zoom, Jitsi, WebEx, BigBlueButton.
 * Names and trademarks of these apps belong the corresponding owners. This work is not affiliated to the aforesaid firms and/or collectives.
 * It is inspired by the work of others thankfully published at  https://www.instructables.com/Arduino-Dual-Function-Button-Long-PressShort-Press/, https://www.sparkfun.com/tutorials/337, https://github.com/ArminJo/Talkie/ and https://www.arduino.cc/en/Reference/EEPROM
 * Details on how to build this button you may find under the URL mentioned above.
 * This code was written by Yves Jeanrenaud. It is far perfect, not optimised and not following many practices of good coding paradigms due to the lack of time. Feel free to file a pull request if you have time to optimise.
 * 
 * v1.5; added speaker to announce chosen key setting
 * v1.4; added EEPROM functions to store the key setting beyond poweoff
 * v1.3; second pushbutton to switch key setting
 * v1.2; added fallover for button delay
 * v1.1; host_is_shut_down to change LED behaviour when USB host is not online - NON FUNCTIONAL
 * v1.0; initial release
 */

int LED1 = 3; //D3 connecting the LED of the pushbutton
int button = 7; //D7 connecting pushbutton; normally open. Cause only 0,1,2,3 and 7 are external interrupts
int button2 = 2; //D2/SDA connecting the second pushbutton; normally open

#define KEY_SPACE 0x20
#define EEADDR 15324

byte keyOptionVar = 153; //bogus value; 0 is webex, 1 is bigbluebutton,2 is jitsi and default is zoom

#include "Keyboard.h"
#include <EEPROM.h> 
//#include "USBStatus.h" does not work as expected, yet
#include "Talkie.h"

//voice recordings
const uint8_t bigbluebutton[] PROGMEM = {0x00,0x00,0x00,0x80,0x46,0x16,0xB3,0x23,0x4C,0xB2,0x89,0x65,0xC8,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0x97,0x61};
const uint8_t zoom[] PROGMEM = {0x00,0x00,0x00,0x00,0x00,0x00,0x00,0x08,0x4D,0x41,0x25,0xBB,0xAC,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0xE8,0x32};
const uint8_t jitsi[] PROGMEM = {0x00,0x00,0x00,0x00,0x88,0xAE,0xD2,0xD4,0x22,0x12,0x21,0xAA,0x18,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0x2E,0xC3};
const uint8_t webex[] PROGMEM = {0x00,0x00,0x00,0x00,0x00,0x00,0x00,0x00,0x80,0x80,0x65,0x67,0xD0,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0xE8,0x32};

//create talkie object
Talkie voice(true,true);

//set start values
boolean LED1State = false;

long buttonTimer = 0;
long button2Timer = 0;
long longPressTime = 250;

boolean buttonActive = false;
boolean button2Active = false;
boolean longPressActive = false;

void setup() {
  //init GPIOS we will use
  pinMode(LED1, OUTPUT);
  pinMode(button, INPUT_PULLUP);
  pinMode(button2, INPUT_PULLUP);
  digitalWrite(button, HIGH); //pullup enabled because it is a dumb switch
  digitalWrite(LED1, false);
  digitalWrite(button2, HIGH); //pullup enabled, too

  //now read the key values once from EEPROM
  EEPROM.get(EEADDR,keyOptionVar);
  //debugging
  Serial.begin(9600); //fast enough
  Serial.print("keyOptionVar at startup is ="); Serial.println(keyOptionVar);
  switch (keyOptionVar) { //switch through the values
    case 0: 
      Serial.println("WebEx");
      break;
    case 1:
      Serial.println("BigBlueButton");
      break;
    case 2:
      Serial.println("Jitsi");
      break;
    default:
      Serial.println("Zoom(default)");
      break;
  }
  //now start the USB HID keyboard
  Keyboard.begin();
  Serial.println("all set up");
}

void loop() {
  if (digitalRead(button) == LOW) { 

    if (buttonActive == false) { 

      buttonActive = true;
      buttonTimer = millis();
      delay(100);

    }

    if ((millis() - buttonTimer > longPressTime) && (longPressActive == false)) {
      Serial.println("long press detected");
      longPressActive = true;
      //LED1State = !LED1State; //we do not want to toggle the LED during long press. long press does always light up the LED
      LED1State = true;
      digitalWrite(LED1, LED1State);
      switch (keyOptionVar) {
        case 0: 
          Serial.println("PRESS SPACE for WebEx");
          Keyboard.press(KEY_SPACE);
          break;
        case 1:
          Serial.println("BigBlueButton has no push2talk");
          //BBB has no push to talk
          break;
        case 2: //JITSI
          Serial.println("PRESS SPACE for Jitsi");
          Keyboard.press(KEY_SPACE);
          break;
        default: //ZOOM
          Serial.println("PRESS SPACE for Zoom");
          Keyboard.press(KEY_SPACE);
          break;
      }
   }

  } else {
    
    if (buttonActive == true) {
      Serial.println("button press detected");
      if (longPressActive == true) {
        if (keyOptionVar != 1) { //not BigBlueButton
          Serial.println("RELEASE SPACE");
          Keyboard.release(KEY_SPACE);
        }
        longPressActive = false;
        LED1State = false;
        digitalWrite(LED1, LED1State);
      } else {
        //press action
        Serial.println("button press executed:");
        
        LED1State = !LED1State;
        digitalWrite(LED1, LED1State);

        switch (keyOptionVar) { //switch through key setting to determine what to do
          case 0: 
            Serial.println("SEND CTRL+ALT+M for WebEx");
            Keyboard.press(KEY_LEFT_CTRL);
            Keyboard.press(KEY_LEFT_ALT);
            Keyboard.write('m');
            Keyboard.release(KEY_LEFT_ALT);
            Keyboard.release(KEY_LEFT_CTRL);
            break;
          case 1:
            Serial.println("SEND ALT+SHIFT+M BigBlueButton");
            Keyboard.press(KEY_LEFT_ALT);
            Keyboard.press(KEY_LEFT_SHIFT);
            Keyboard.write('m');
            Keyboard.release(KEY_LEFT_SHIFT);
            Keyboard.release(KEY_LEFT_ALT);
            break;
          case 2: //JITSI
            Serial.println("SEND ALT+M for Jitsi"); //BBB keyboard shortcut would also work because Jitsi ignores the shift key pressed
            Keyboard.press(KEY_LEFT_ALT);
            Keyboard.write('m');
            Keyboard.release(KEY_LEFT_ALT);

            break;
          default: //ZOOM
            Serial.println("SEND ALT+A for Zoom");
            Keyboard.press(KEY_LEFT_ALT);
            Keyboard.write('a');
            Keyboard.release(KEY_LEFT_ALT);
            break;
        }
      }

      buttonActive = false;

    }
  }
  //the second pushbutton selects what key to send and stores this setting in EEPROM
  if (digitalRead(button2) == LOW) {
     if (button2Active == false) {
        button2Active = true;
        delay(100);
     }
     } else {
     if (button2Active == true) {
        Serial.println("button2 press detected");
        //now cicle through the key options we got:Zoom, webEx, BigBlueButton,Jitsi
        EEPROM.get(EEADDR,keyOptionVar);
        Serial.print("keyOptionVar from EEPROM is "); Serial.println(keyOptionVar);
        switch (keyOptionVar) {
          case 0: 
            Serial.println("WebEx");
            EEPROM.put(EEADDR,1);
            Serial.println("set to BigBlueButton");
            voice.say(bigbluebutton);
            break;
          case 1:
            Serial.println("BigBlueButton");
            EEPROM.put(EEADDR,2);
            Serial.println("set to Jitsi");
            voice.say(jitsi);
            break;
          case 2:
            Serial.println("Jitsi");
            EEPROM.put(EEADDR,3);
            Serial.println("set to Zoom");
            voice.say(zoom);
            break;
          default:
            Serial.println("Zoom(Default)");
            EEPROM.put(EEADDR,0);
            Serial.println("set to WebEx");
            voice.say(webex);
            break;
        }
        //now reset the led and the button state 
        buttonActive = false;
        longPressActive = false;
        LED1State = false;
        digitalWrite(LED1, LED1State);
      }
     button2Active = false;
     
  }
  
//kept here for future work  
/*  bool host_is_shut_down = USBStatus.isShutDown();
  while (host_is_shut_down ==true) {
     digitalWrite(LED1, (millis() / 1000) % 2);
    }*/
}//end of loop
